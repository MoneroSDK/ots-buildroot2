## Config.in
```kconfig
config BR2_PACKAGE_MONERO_OTS
	bool "monero-ots"
	depends on BR2_INSTALL_LIBSTDCPP
	depends on BR2_TOOLCHAIN_HAS_THREADS
	depends on BR2_USE_WCHAR
	select BR2_PACKAGE_BOOST
	select BR2_PACKAGE_BOOST_FILESYSTEM
	select BR2_PACKAGE_BOOST_THREAD
	select BR2_PACKAGE_BOOST_SYSTEM
	select BR2_PACKAGE_BOOST_CHRONO
	select BR2_PACKAGE_BOOST_SERIALIZATION
	select BR2_PACKAGE_OPENSSL
	help
	  Monero OTS (One-Time-Signature) library.

	  This library provides One-Time-Signature functionality for the Monero 
	  cryptocurrency. It is designed to work with the Monero source tree.

	  https://github.com/DiosDelRayo/monero/tree/otslib
	  https://github.com/MoneroSDK/ots-buildroot2
	  
	  License: BipCot NoGov 1.3

comment "monero-ots needs a toolchain w/ C++, threads, wchar"
	depends on !BR2_INSTALL_LIBSTDCPP || !BR2_TOOLCHAIN_HAS_THREADS || !BR2_USE_WCHAR
```
